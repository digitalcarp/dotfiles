/*
 * Copyright (c) 2020 The ZMK Contributors
 * Copyright (c) 2025 Innaworks Development Limited, trading as MoErgo
 *
 * SPDX-License-Identifier: MIT
 */


/* THIS FILE WAS GENERATED BY GLOVE80 LAYOUT EDITOR
 *
 * This file was generated automatically. You may or may not want to
 * edit it directly.
 */

#include <behaviors.dtsi>
/* Include all behavior includes needed */
#include <dt-bindings/zmk/outputs.h>
#include <dt-bindings/zmk/keys.h>
#include <dt-bindings/zmk/bt.h>
#include <dt-bindings/zmk/rgb.h>

/* On demand includes */
#include <dt-bindings/zmk/pointing.h>

/* Helper Macros, based on https://github.com/urob/zmk-helpers/ */

#pragma once

#define ZMK_HELPER_STRINGIFY(x) #x

// Preprocessor mechanism to overload macros, cf. https://stackoverflow.com/a/27051616/6114651
#define VARGS_(_10, _9, _8, _7, _6, _5, _4, _3, _2, _1, N, ...) N
#define VARGS(...) VARGS_(__VA_ARGS__, 10, 9, 8, 7, 6, 5, 4, 3, 2, 1, 0)
#define CONCAT_(a, b) a##b
#define CONCAT(a, b) CONCAT_(a, b)

#define ZMK_BEHAVIOR_CORE_tap_dance  \
    compatible = "zmk,behavior-tap-dance"; \
    #binding-cells = <0>

#define ZMK_BEHAVIOR(name, type, ...) \
    name: name { \
        ZMK_BEHAVIOR_CORE_ ## type; \
        __VA_ARGS__ \
    };

#define ZMK_TAP_DANCE(name, ...) \
    ZMK_BEHAVIOR(name, tap_dance, __VA_ARGS__)

#define ZMK_TD_LAYER(name, layer) \
    ZMK_TAP_DANCE(name, \
        tapping-term-ms = <200>; \
        bindings = <&mo layer>, <&to layer>; \
)

/* Environment and metadata defines */
#define KB_TYPE_GLOVE_80 1
#define KB_TYPE_GO_60    2

#define KB_TYPE          KB_TYPE_GLOVE_80
#define EDITOR_HOST_OS   'W'

/* Automatically generated layer name defines */
#define LAYER_Base 0
#define LAYER_Lower 1
#define LAYER_Symbol 2
#define LAYER_Number 3
#define LAYER_Cursor 4
#define LAYER_Function 5
#define LAYER_Sticky 6
#define LAYER_Magic 7
#define LAYER_ak_D 8
#define LAYER_ak_G 9
#define LAYER_ak_M 10
#define LAYER_ak_F 11

/* To deal with the situation where there is no Lower layer, to keep &lower happy */
#ifndef LAYER_Lower
#define LAYER_Lower 0
#endif

/* Custom Device-tree */


/* Input Listeners */


/* System behavior and Macros */
/ {
    behaviors {
        ZMK_TD_LAYER(lower, LAYER_Lower)
    };
};

/ {
    macros {
        rgb_ug_status_macro: rgb_ug_status_macro {
            label = "RGB_UG_STATUS";
            compatible = "zmk,behavior-macro";
            #binding-cells = <0>;
            bindings
                = <&rgb_ug RGB_STATUS>;
        };
    };
};


/ {
#ifdef BT_DISC_CMD
    behaviors {
        bt_0: bt_0 {
            compatible = "zmk,behavior-tap-dance";
            label = "BT_0";
            #binding-cells = <0>;
            tapping-term-ms = <200>;
            bindings = <&bt_select_0>, <&bt BT_DISC 0>;
        };
        bt_1: bt_1 {
            compatible = "zmk,behavior-tap-dance";
            label = "BT_1";
            #binding-cells = <0>;
            tapping-term-ms = <200>;
            bindings = <&bt_select_1>, <&bt BT_DISC 1>;
        };
        bt_2: bt_2 {
            compatible = "zmk,behavior-tap-dance";
            label = "BT_2";
            #binding-cells = <0>;
            tapping-term-ms = <200>;
            bindings = <&bt_select_2>, <&bt BT_DISC 2>;
        };
        bt_3: bt_3 {
            compatible = "zmk,behavior-tap-dance";
            label = "BT_3";
            #binding-cells = <0>;
            tapping-term-ms = <200>;
            bindings = <&bt_select_3>, <&bt BT_DISC 3>;
        };
    };
    macros {
        bt_select_0: bt_select_0 {
            label = "BT_SELECT_0";
            compatible = "zmk,behavior-macro";
            #binding-cells = <0>;
            bindings
                = <&out OUT_BLE>,
                  <&bt BT_SEL 0>;
        };
        bt_select_1: bt_select_1 {
            label = "BT_SELECT_1";
            compatible = "zmk,behavior-macro";
            #binding-cells = <0>;
            bindings
                = <&out OUT_BLE>,
                  <&bt BT_SEL 1>;
        };
        bt_select_2: bt_select_2 {
            label = "BT_SELECT_2";
            compatible = "zmk,behavior-macro";
            #binding-cells = <0>;
            bindings
                = <&out OUT_BLE>,
                  <&bt BT_SEL 2>;
        };
        bt_select_3: bt_select_3 {
            label = "BT_SELECT_3";
            compatible = "zmk,behavior-macro";
            #binding-cells = <0>;
            bindings
                = <&out OUT_BLE>,
                  <&bt BT_SEL 3>;
        };
    };
#else
    macros {
        bt_0: bt_0 {
            label = "BT_0";
            compatible = "zmk,behavior-macro";
            #binding-cells = <0>;
            bindings
                = <&out OUT_BLE>,
                  <&bt BT_SEL 0>;
        };
        bt_1: bt_1 {
            label = "BT_1";
            compatible = "zmk,behavior-macro";
            #binding-cells = <0>;
            bindings
                = <&out OUT_BLE>,
                  <&bt BT_SEL 1>;
        };
        bt_2: bt_2 {
            label = "BT_2";
            compatible = "zmk,behavior-macro";
            #binding-cells = <0>;
            bindings
                = <&out OUT_BLE>,
                  <&bt BT_SEL 2>;
        };
        bt_3: bt_3 {
            label = "BT_3";
            compatible = "zmk,behavior-macro";
            #binding-cells = <0>;
            bindings
                = <&out OUT_BLE>,
                  <&bt BT_SEL 3>;
        };
    };
#endif
};

/ {
    behaviors {
        magic: magic {
            compatible = "zmk,behavior-hold-tap";
            label = "MAGIC_HOLD_TAP";
            #binding-cells = <2>;
            flavor = "tap-preferred";
            tapping-term-ms = <200>;
            bindings = <&mo>, <&rgb_ug_status_macro>;
        };
    };
};


/* Key positions */

#define POS_LH_C6R1 0
#define POS_LH_C5R1 1
#define POS_LH_C4R1 2
#define POS_LH_C3R1 3
#define POS_LH_C2R1 4
#define POS_RH_C2R1 5
#define POS_RH_C3R1 6
#define POS_RH_C4R1 7
#define POS_RH_C5R1 8
#define POS_RH_C6R1 9
#define POS_LH_C6R2 10
#define POS_LH_C5R2 11
#define POS_LH_C4R2 12
#define POS_LH_C3R2 13
#define POS_LH_C2R2 14
#define POS_LH_C1R2 15
#define POS_RH_C1R2 16
#define POS_RH_C2R2 17
#define POS_RH_C3R2 18
#define POS_RH_C4R2 19
#define POS_RH_C5R2 20
#define POS_RH_C6R2 21
#define POS_LH_C6R3 22
#define POS_LH_C5R3 23
#define POS_LH_C4R3 24
#define POS_LH_C3R3 25
#define POS_LH_C2R3 26
#define POS_LH_C1R3 27
#define POS_RH_C1R3 28
#define POS_RH_C2R3 29
#define POS_RH_C3R3 30
#define POS_RH_C4R3 31
#define POS_RH_C5R3 32
#define POS_RH_C6R3 33
#define POS_LH_C6R4 34
#define POS_LH_C5R4 35
#define POS_LH_C4R4 36
#define POS_LH_C3R4 37
#define POS_LH_C2R4 38
#define POS_LH_C1R4 39
#define POS_RH_C1R4 40
#define POS_RH_C2R4 41
#define POS_RH_C3R4 42
#define POS_RH_C4R4 43
#define POS_RH_C5R4 44
#define POS_RH_C6R4 45
#define POS_LH_C6R5 46
#define POS_LH_C5R5 47
#define POS_LH_C4R5 48
#define POS_LH_C3R5 49
#define POS_LH_C2R5 50
#define POS_LH_C1R5 51
#define POS_LH_T1 52
#define POS_LH_T2 53
#define POS_LH_T3 54
#define POS_RH_T3 55
#define POS_RH_T2 56
#define POS_RH_T1 57
#define POS_RH_C1R5 58
#define POS_RH_C2R5 59
#define POS_RH_C3R5 60
#define POS_RH_C4R5 61
#define POS_RH_C5R5 62
#define POS_RH_C6R5 63
#define POS_LH_C6R6 64
#define POS_LH_C5R6 65
#define POS_LH_C4R6 66
#define POS_LH_C3R6 67
#define POS_LH_C2R6 68
#define POS_LH_T4 69
#define POS_LH_T5 70
#define POS_LH_T6 71
#define POS_RH_T6 72
#define POS_RH_T5 73
#define POS_RH_T4 74
#define POS_RH_C2R6 75
#define POS_RH_C3R6 76
#define POS_RH_C4R6 77
#define POS_RH_C5R6 78
#define POS_RH_C6R6 79


/* Custom Defined Behaviors */
/ {
#define  LEFT_HAND_KEYS    \
          0  1  2  3  4    \
         10 11 12 13 14 15 \
         22 23 24 25 26 27 \
         34 35 36 37 38 39 \
         46 47 48 49 50 51 \
         64 65 66 67 68
#define                                  RIGHT_HAND_KEYS \
                                           5  6  7  8  9 \
                                       16 17 18 19 20 21 \
                                       28 29 30 31 32 33 \
                                       40 41 42 43 44 45 \
                                       58 59 60 61 62 63 \
                                          75 76 77 78 79
#define          LEFT_THUMB_KEYS \
                        69 52    \
                         70 53   \
                          71 54

#define                           RIGHT_THUMB_KEYS \
                                    57 74          \
                                   56 73           \
                                  55 72

#define HRM_TAP_TERM_MS 300
#define HRM_QUICK_TAP_MS 220
#define HRM_REQUIRE_PRIOR_IDLE_MS 150

#define HOME_ROW_MOD_PROPS(TAP_TERM_MS)                  \
    compatible = "zmk,behavior-hold-tap";                \
    tapping-term-ms = <TAP_TERM_MS>;                     \
    quick-tap-ms = <HRM_QUICK_TAP_MS>;                   \
    require-prior-idle-ms = <HRM_REQUIRE_PRIOR_IDLE_MS>; \
    flavor = "balanced";                                 \
    hold-trigger-on-release;                             \
    #binding-cells = <2>;

#define HOME_ROW_MOD_LEFT_PROPS(TAP_TERM_MS) \
    HOME_ROW_MOD_PROPS(TAP_TERM_MS)          \
    hold-trigger-key-positions = <RIGHT_HAND_KEYS RIGHT_THUMB_KEYS>;

#define HOME_ROW_MOD_RIGHT_PROPS(TAP_TERM_MS) \
    HOME_ROW_MOD_PROPS(TAP_TERM_MS)           \
    hold-trigger-key-positions = <LEFT_HAND_KEYS LEFT_THUMB_KEYS>;

#define SHIFT_MOD_MORPH(NAME, LABEL, LOWER, UPPER) \
    NAME: LABEL {                                  \
        compatible = "zmk,behavior-mod-morph";     \
        mods = <(MOD_LSFT)>;                       \
        #binding-cells = <0>;                      \
        bindings = <&kp LOWER>, <&kp UPPER>;       \
    }

behaviors {
    behavior_caps_word {
        continue-list = <UNDERSCORE MINUS BACKSPACE DELETE N1 N2 N3 N4 N5 N6 N7 N8 N9 N0>;
    };

    aksl: adaptive_key_sticky_layer {
        compatible = "zmk,behavior-sticky-key";
        #binding-cells = <1>;
        bindings = <&mo>;
        release-after-ms = <100>;
        quick-release;
    };

    SHIFT_MOD_MORPH(mm_st_and, mod_morph_star_and, STAR, AMPS);
    SHIFT_MOD_MORPH(mm_cm_eq, mod_morph_comma_equal, COMMA, EQUAL);
    SHIFT_MOD_MORPH(mm_period_excl, mod_morph_period_excl, PERIOD, EXCL);
    SHIFT_MOD_MORPH(mm_us_min, mod_morph_underscore_minus, UNDERSCORE, MINUS);
    SHIFT_MOD_MORPH(mm_pd_lp, mod_morph_page_down_left_parenthesis, PG_DN, LPAR);
    SHIFT_MOD_MORPH(mm_pu_rp, mod_morph_page_up_right_parenthesis, PG_UP, RPAR);

    // Format: &hrm_* <HOLD> <TAP>
    hrm_l: home_row_mods_left {
        HOME_ROW_MOD_LEFT_PROPS(HRM_TAP_TERM_MS)
        bindings = <&kp>, <&kp>;
    };
    hrm_r: home_row_mods_right {
        HOME_ROW_MOD_RIGHT_PROPS(HRM_TAP_TERM_MS)
        bindings = <&kp>, <&kp>;
    };

    hrm_l_period_excl: home_row_mods_left_period_exclamation {
        HOME_ROW_MOD_RIGHT_PROPS(HRM_TAP_TERM_MS)
        bindings = <&kp>, <&mm_period_excl>;
    };
    hrm_l_comma_equal: home_row_mods_left_comma_equal {
        HOME_ROW_MOD_RIGHT_PROPS(HRM_TAP_TERM_MS)
        bindings = <&kp>, <&mm_cm_eq>;
    };
    hrm_r_akf: home_row_mods_right_akf {
        HOME_ROW_MOD_LEFT_PROPS(HRM_TAP_TERM_MS)
        bindings = <&kp>, <&AK_F>;
    };
    hrm_r_akg: home_row_mods_right_akg {
        HOME_ROW_MOD_LEFT_PROPS(HRM_TAP_TERM_MS)
        bindings = <&kp>, <&AK_G>;
    };
    hrm_r_akm: home_row_mods_right_akm {
        HOME_ROW_MOD_LEFT_PROPS(HRM_TAP_TERM_MS)
        bindings = <&kp>, <&AK_M>;
    };
};

#define INST_MACRO(NAME, ...) \
    ZMK_MACRO(NAME,           \
        wait-ms = <0>;        \
        tap-ms = <0>;         \
        __VA_ARGS__           \
    )

#define AK_MACRO(KEY)                                   \
    INST_MACRO(AK_ ## KEY,                              \
        bindings = <&kp KEY>, <&aksl LAYER_ak_ ## KEY>; \
    )

macros {
    AK_MACRO(D)
    AK_MACRO(F)
    AK_MACRO(G)
    AK_MACRO(M)
};
};

/* Generated input processors */


/* Automatically generated macro definitions */
/ {
    macros {

        // tmux prefix
        tmux_prefix: tmux_prefix {
            label = "&TMUX_PREFIX";
            compatible = "zmk,behavior-macro";
            #binding-cells = <0>;
            tap-ms = <0>;
            wait-ms = <0>;
            bindings = <&kp LC(A)>;
        };

        // Change tmux session
        tmux_cs: tmux_cs {
            label = "&TMUX_CS";
            compatible = "zmk,behavior-macro";
            #binding-cells = <0>;
            tap-ms = <0>;
            wait-ms = <0>;
            bindings = <&tmux_prefix>
                , <&kp S>
                , <&sl LAYER_Number>;
        };

        // Change tmux window
        tmux_cw: tmux_cw {
            label = "&TMUX_CW";
            compatible = "zmk,behavior-macro";
            #binding-cells = <0>;
            tap-ms = <0>;
            wait-ms = <0>;
            bindings = <&tmux_prefix>
                , <&sl LAYER_Number>;
        };

        // Change tmux pane
        tmux_cp: tmux_cp {
            label = "&TMUX_CP";
            compatible = "zmk,behavior-macro";
            #binding-cells = <0>;
            tap-ms = <0>;
            wait-ms = <0>;
            bindings = <&tmux_prefix>
                , <&kp Q>
                , <&sl LAYER_Number>;
        };

        // Activate tmux command
        tmux_cmd: tmux_cmd {
            label = "&TMUX_CMD";
            compatible = "zmk,behavior-macro-one-param";
            #binding-cells = <1>;
            tap-ms = <0>;
            wait-ms = <0>;
            bindings = <&tmux_prefix>
                , <&macro_param_1to1>
                , <&kp MACRO_PLACEHOLDER>;
        };

        // Apply a single letter vim colon command
        vim_cli: vim_cli {
            label = "&VIM_CLI";
            compatible = "zmk,behavior-macro-one-param";
            #binding-cells = <1>;
            tap-ms = <0>;
            wait-ms = <0>;
            bindings = <&kp LS(SEMI)>
                , <&macro_param_1to1>
                , <&kp MACRO_PLACEHOLDER>
                , <&kp RET>;
        };

        // Apply a two letter vim colon command
        vim_cli2: vim_cli2 {
            label = "&VIM_CLI2";
            compatible = "zmk,behavior-macro-two-param";
            #binding-cells = <2>;
            tap-ms = <0>;
            wait-ms = <0>;
            bindings = <&kp LS(SEMI)>
                , <&macro_param_1to1>
                , <&kp MACRO_PLACEHOLDER>
                , <&macro_param_1to1>
                , <&kp MACRO_PLACEHOLDER>
                , <&kp RET>;
        };

        // Adaptive which adjusts the first letter
        akfix: akfix {
            label = "&AKFIX";
            compatible = "zmk,behavior-macro-two-param";
            #binding-cells = <2>;
            tap-ms = <0>;
            wait-ms = <0>;
            bindings = <&kp BSPC>
                , <&macro_param_1to1>
                , <&kp MACRO_PLACEHOLDER>
                , <&macro_param_2to1>
                , <&kp MACRO_PLACEHOLDER>;
        };

        // Keypress then go to sticky layer
        kp_sk_in: kp_sk_in {
            label = "&KP_SK_IN";
            compatible = "zmk,behavior-macro-one-param";
            #binding-cells = <1>;
            tap-ms = <0>;
            wait-ms = <0>;
            bindings = <&macro_param_1to1>
                , <&kp MACRO_PLACEHOLDER>
                , <&to LAYER_Sticky>;
        };

        // Keypress then leave sticky layer
        kp_sk_out: kp_sk_out {
            label = "&KP_SK_OUT";
            compatible = "zmk,behavior-macro-one-param";
            #binding-cells = <1>;
            tap-ms = <0>;
            wait-ms = <0>;
            bindings = <&macro_param_1to1>
                , <&kp MACRO_PLACEHOLDER>
                , <&tog LAYER_Sticky>;
        };
    };
};

/* Automatically generated behavior definitions */
/ {
    behaviors {


        // Layer tap with sticky key tap
        lt_sk: lt_sk {
            compatible = "zmk,behavior-hold-tap";
            #binding-cells = <2>;
            tapping-term-ms = <400>;
            bindings = <&mo>, <&sk>;
            flavor = "tap-preferred";
        };

        // Hold tap with sticky key tap
        ht_sk: ht_sk {
            compatible = "zmk,behavior-hold-tap";
            #binding-cells = <2>;
            tapping-term-ms = <200>;
            bindings = <&kp>, <&sk>;
            flavor = "balanced";
            hold-while-undecided;
            hold-while-undecided-linger;
        };

        // CAPS_WORD tap with key press hold
        ht_caps: ht_caps {
            compatible = "zmk,behavior-hold-tap";
            #binding-cells = <2>;
            tapping-term-ms = <400>;
            bindings = <&kp>, <&caps_word>;
            flavor = "tap-preferred";
        };

        // Hold tap with longer tapping term
        ht_slow: ht_slow {
            compatible = "zmk,behavior-hold-tap";
            #binding-cells = <2>;
            tapping-term-ms = <400>;
            bindings = <&kp>, <&kp>;
            flavor = "tap-preferred";
        };

        // Layer tap with longer tapping term
        lt_slow: lt_slow {
            compatible = "zmk,behavior-hold-tap";
            #binding-cells = <2>;
            tapping-term-ms = <400>;
            bindings = <&mo>, <&kp>;
            flavor = "tap-preferred";
        };
    };
};

/* Automatically generated combos definitions */
/ {
    combos {
        compatible = "zmk,combos";

        // Ctrl-Shift-V
        combo_paste_raw {
            timeout-ms = <50>;
            key-positions = <POS_LH_C3R5 POS_LH_C2R5 POS_LH_C5R5>;
            bindings = <&kp LC(LS(V))>;
            layers = <LAYER_Base>;
            require-prior-idle-ms = <300>;
        };

        // Ctrl-Shift-C
        combo_copy_raw {
            timeout-ms = <50>;
            key-positions = <POS_LH_C5R5 POS_LH_C3R5 POS_LH_C4R5>;
            bindings = <&kp LC(LS(C))>;
            layers = <LAYER_Base>;
            require-prior-idle-ms = <300>;
        };

        // Ctrl-Z
        combo_undo {
            timeout-ms = <50>;
            key-positions = <POS_LH_C5R5 POS_LH_C4R5>;
            bindings = <&kp LC(Z)>;
            layers = <LAYER_Base>;
            require-prior-idle-ms = <300>;
        };

        // Ctrl-V
        combo_paste {
            timeout-ms = <50>;
            key-positions = <POS_LH_C3R5 POS_LH_C2R5>;
            bindings = <&kp LC(V)>;
            layers = <LAYER_Base>;
            require-prior-idle-ms = <300>;
        };

        // Ctrl-X
        combo_cut {
            timeout-ms = <50>;
            key-positions = <POS_LH_C5R5 POS_LH_C3R5>;
            bindings = <&kp LC(X)>;
            layers = <LAYER_Base>;
            require-prior-idle-ms = <300>;
        };

        // Ctrl-C
        combo_copy {
            timeout-ms = <50>;
            key-positions = <POS_LH_C4R5 POS_LH_C3R5>;
            bindings = <&kp LC(C)>;
            layers = <LAYER_Base>;
            require-prior-idle-ms = <300>;
        };
    };
};

/* Automatically generated keymap */
/ {
    keymap {
        compatible = "zmk,keymap";


        layer_Base {
            bindings = <
        &kp LG(LS(S))                 &kp LG(D)                   &kp LALT                   &kp LCTRL           &kp LSHFT                                                                                                                                               &kp RSHFT           &kp RCTRL           &kp RALT         &trans               &kp INS
               &trans                    &trans                     &trans                      &kp N0              &trans      &trans                                                                                                                 &trans               &trans              &kp N1             &trans         &trans               &kp DEL
              &kp TAB                     &kp Q                      &kp Y                       &kp O               &kp U  &mm_st_and                                                                                                                  &kp X                &kp L               &AK_D              &kp P          &kp Z                &trans
                &kp B                     &kp C                      &kp I                       &kp A               &kp E  &mm_us_min                                                                                                                  &kp K                &kp H               &kp T              &kp N          &kp S                 &kp W
   &ht_sk LSHFT LSHFT  &hrm_l LGUI SINGLE_QUOTE  &hrm_l_comma_equal LALT 0  &hrm_l_period_excl LCTRL 0  &hrm_l LSHIFT SEMI    &kp FSLH  &lt_slow LAYER_Function ESC            &ht_caps CAPS 0  &trans  &kp LS(N2)  &key_repeat  &lt LAYER_Symbol RET   &kp J  &hrm_r_akm LSHIFT 0  &hrm_r_akg LCTRL 0  &hrm_r_akf LALT 0  &hrm_r LGUI V    &ht_sk RSHFT LSHFT
 &magic LAYER_Magic 0                    &trans                     &trans                &tmux_prefix              &trans              &lt_slow LAYER_Cursor SPACE  &lt_sk LAYER_Number LSHFT  &lower      &lower     &kp BSPC                 &kp R                     &kp HOME           &mm_pd_lp          &mm_pu_rp        &kp END  &magic LAYER_Magic 0
            >;
        };

        layer_Lower {
            bindings = <
               &trans  &trans        &trans          &trans    &trans                                                                                                                               &trans          &trans        &trans           &trans                &trans
               &trans  &trans        &trans          &trans    &trans  &trans                                                                                                       &trans          &trans          &trans        &trans           &trans                &trans
               &trans  &trans        &trans          &trans    &trans  &trans                                                                                                       &trans          &trans          &trans        &trans           &trans                &trans
               &trans  &trans      &mkp MB2        &mkp MB3  &mkp MB1  &trans                                                                                                       &trans  &mmv MOVE_LEFT  &mmv MOVE_DOWN  &mmv MOVE_UP  &mmv MOVE_RIGHT                &trans
               &trans  &trans  &msc SCRL_UP  &msc SCRL_DOWN    &trans  &trans             &trans             &trans            &trans            &trans  &trans  &tog LAYER_Symbol  &trans          &trans          &trans        &trans           &trans                &trans
 &magic LAYER_Magic 0  &trans        &trans          &trans    &trans          &tog LAYER_Cursor  &tog LAYER_Number  &tog LAYER_Lower  &tog LAYER_Lower  &trans             &trans                  &trans          &trans        &trans           &trans  &magic LAYER_Magic 0
            >;
        };

        layer_Symbol {
            bindings = <
        &trans         &trans        &trans        &trans       &trans                                                                                                                &trans    &trans  &trans  &trans  &trans
        &trans         &trans        &trans    &kp LS(N1)       &trans        &trans                                                                                     &trans       &trans    &trans  &trans  &trans  &trans
    &kp LS(N3)      &kp GRAVE    &kp LS(N9)    &kp LS(N0)     &kp SEMI  &kp LS(FSLH)                                                                                     &trans    &kp COMMA    &trans  &trans  &trans  &trans
    &kp LS(N6)     &kp LS(N4)  &kp LS(LBKT)  &kp LS(RBKT)   &kp LS(N8)  &kp LS(SEMI)                                                                              &kp LS(EQUAL)  &kp LS(SQT)   &kp SQT  &trans  &trans  &trans
 &kp LS(GRAVE)  &kp LS(COMMA)     &kp EQUAL     &kp MINUS  &kp LS(DOT)      &kp FSLH  &kp BSLH  &kp LS(N2)             &trans             &trans  &trans  &trans         &trans    &kp SPACE  &kp BSPC  &trans  &trans  &trans
        &trans       &kp LBKT    &kp LS(N7)  &kp LS(BSLH)     &kp RBKT                 &kp DOT  &kp LS(N5)  &tog LAYER_Symbol  &tog LAYER_Symbol  &trans  &trans                      &trans    &trans  &trans  &trans  &trans
            >;
        };

        layer_Number {
            bindings = <
 &trans  &trans    &trans         &trans              &trans                                                                                                                    &trans               &trans                  &trans        &trans         &trans
 &trans  &trans    &trans         &trans              &trans     &trans                                                                              &kp LS(BSLH)  &ht_slow F10 LS(N3)  &ht_slow F11 LS(N4)  &ht_slow F12 LS(GRAVE)    &kp LS(N2)         &trans
 &trans  &trans    &trans         &trans              &trans     &trans                                                                                     &kp K       &ht_slow F7 N7       &ht_slow F8 N8          &ht_slow F9 N9  &kp LS(SEMI)     &kp LS(N5)
 &trans  &trans  &tmux_cp       &tmux_cw            &tmux_cs     &trans                                                                                 &kp LS(G)       &ht_slow F4 N4       &ht_slow F5 N5          &ht_slow F6 N6     &kp MINUS  &kp LS(EQUAL)
 &trans  &trans  &kp LALT      &kp LCTRL  &ht_sk LSHFT LSHFT  &kp SPACE  &trans  &trans             &trans             &trans  &kp EQUAL  &kp COMMA         &kp J       &ht_slow F1 N1       &ht_slow F2 N2          &ht_slow F3 N3      &kp FSLH     &kp LS(N8)
 &trans  &trans    &trans  &kp LS(COMMA)         &kp LS(DOT)             &trans  &trans  &tog LAYER_Number  &tog LAYER_Number    &kp DOT     &kp N0                           &kp LBKT           &kp LS(N9)              &kp LS(N0)      &kp RBKT         &trans
            >;
        };

        layer_Cursor {
            bindings = <
 &trans           &trans       &trans                 &trans       &trans                                                                                           &trans     &trans     &trans     &trans  &trans
 &trans           &trans       &trans                 &trans       &trans  &trans                                                                        &trans     &trans     &trans     &trans     &trans  &trans
 &trans           &trans       &trans                 &trans       &trans  &trans                                                                        &trans  &kp LC(H)  &kp LC(J)  &kp LC(K)  &kp LC(L)  &trans
 &trans  &kp LC(LS(TAB))  &kp LA(TAB)  &kp_sk_in LC(LA(TAB))  &kp LC(TAB)  &trans                                                                        &trans   &kp LEFT   &kp DOWN     &kp UP  &kp RIGHT  &trans
 &trans           &trans     &kp LALT              &kp LCTRL    &kp LSHFT  &trans  &trans  &trans             &trans             &trans  &trans  &trans  &trans   &kp HOME  &kp PG_DN  &kp PG_UP    &kp END  &trans
 &trans           &trans       &trans                 &trans       &trans          &trans  &trans  &tog LAYER_Cursor  &tog LAYER_Cursor  &trans  &trans             &trans     &trans     &trans     &trans  &trans
            >;
        };

        layer_Function {
            bindings = <
 &trans  &trans  &trans  &trans  &trans                                                                                                  &kp PSCRN         &kp SLCK  &trans  &trans      &trans
 &trans  &trans  &trans  &trans  &trans    &trans                                                                            &trans         &trans           &trans  &trans  &trans      &trans
 &trans  &trans  &trans  &trans  &trans    &trans                                                                            &trans    &tmux_cmd V  &tmux_cmd MINUS  &trans  &trans      &trans
 &trans  &trans  &trans  &trans  &trans  &kp BSPC                                                                            &trans     &vim_cli Q    &kp LC(LS(T))  &trans  &trans  &vim_cli W
 &trans  &trans  &trans  &trans  &trans   &kp RET  &trans  &trans               &trans               &trans  &trans  &trans  &trans  &vim_cli2 V S    &vim_cli2 S P  &trans  &trans      &trans
 &trans  &trans  &trans  &trans  &trans            &trans  &trans  &tog LAYER_Function  &tog LAYER_Function  &trans  &trans                 &trans           &trans  &trans  &trans      &trans
            >;
        };

        layer_Sticky {
            bindings = <
 &trans       &trans  &trans          &trans   &trans                                                                  &trans  &trans  &trans  &trans  &trans
 &trans       &trans  &trans          &trans   &trans  &trans                                                  &trans  &trans  &trans  &trans  &trans  &trans
 &trans       &trans  &trans          &trans   &trans  &trans                                                  &trans  &trans  &trans  &trans  &trans  &trans
 &trans  &kp LS(TAB)  &trans  &kp_sk_out RET  &kp TAB  &trans                                                  &trans  &trans  &trans  &trans  &trans  &trans
 &trans       &trans  &trans          &trans   &trans  &trans  &trans  &trans  &trans  &trans  &trans  &trans  &trans  &trans  &trans  &trans  &trans  &trans
 &trans       &trans  &trans          &trans   &trans          &trans  &trans  &trans  &trans  &trans  &trans          &trans  &trans  &trans  &trans  &trans
            >;
        };

        layer_Magic {
            bindings = <
  &bt BT_CLR            &none            &none            &none            &none                                                                                  &none   &none   &none   &none  &bt BT_CLR_ALL
       &none            &none            &none            &none            &none            &none                                                         &none   &none   &none   &none   &none           &none
       &none  &rgb_ug RGB_SPI  &rgb_ug RGB_SAI  &rgb_ug RGB_HUI  &rgb_ug RGB_BRI  &rgb_ug RGB_TOG                                                         &none   &none   &none   &none   &none           &none
 &bootloader  &rgb_ug RGB_SPD  &rgb_ug RGB_SAD  &rgb_ug RGB_HUD  &rgb_ug RGB_BRD  &rgb_ug RGB_EFF                                                         &none   &none   &none   &none   &none     &bootloader
  &sys_reset            &none            &none            &none            &none            &none   &bt_2   &bt_3         &none   &none   &none   &none   &none   &none   &none   &none   &none      &sys_reset
       &none            &none            &none            &none            &none                    &bt_0   &bt_1  &out OUT_USB   &none   &none   &none           &none   &none   &none   &none           &none
            >;
        };

        layer_ak_D {
            bindings = <
 &trans  &trans  &trans  &trans  &trans                                                                  &trans  &trans  &trans  &trans  &trans
 &trans  &trans  &trans  &trans  &trans  &trans                                                  &trans  &trans  &trans  &trans  &trans  &trans
 &trans  &trans  &trans  &trans  &trans  &trans                                                   &kp G  &trans  &trans  &trans  &trans  &trans
 &trans  &trans  &trans  &trans  &trans  &trans                                                  &trans  &trans  &trans  &trans  &trans  &trans
 &trans  &trans  &trans  &trans  &trans  &trans  &trans  &trans  &trans  &trans  &trans  &trans  &trans  &trans  &trans  &trans  &trans  &trans
 &trans  &trans  &trans  &trans  &trans          &trans  &trans  &trans  &trans  &trans  &trans          &trans  &trans  &trans  &trans  &trans
            >;
        };

        layer_ak_G {
            bindings = <
 &trans  &trans  &trans  &trans  &trans                                                                  &trans  &trans  &trans  &trans  &trans
 &trans  &trans  &trans  &trans  &trans  &trans                                                  &trans  &trans  &trans  &trans  &trans  &trans
 &trans  &trans  &trans  &trans  &trans  &trans                                                  &trans  &trans  &trans  &trans  &trans  &trans
 &trans  &trans  &trans  &trans  &trans  &trans                                                  &trans  &trans  &trans  &trans  &trans  &trans
 &trans  &trans  &trans  &trans  &trans  &trans  &trans  &trans  &trans  &trans  &trans  &trans  &trans   &kp L  &trans  &trans  &trans  &trans
 &trans  &trans  &trans  &trans  &trans          &trans  &trans  &trans  &trans  &trans  &trans          &trans  &trans  &trans  &trans  &trans
            >;
        };

        layer_ak_M {
            bindings = <
 &trans  &trans  &trans  &trans  &trans                                                                  &trans      &trans  &trans  &trans  &trans
 &trans  &trans  &trans  &trans  &trans  &trans                                                  &trans  &trans      &trans  &trans  &trans  &trans
 &trans  &trans  &trans  &trans  &trans  &trans                                                  &trans  &trans      &trans  &trans  &trans  &trans
 &trans  &trans  &trans  &trans  &trans  &trans                                                  &trans  &trans      &trans  &trans  &trans  &trans
 &trans  &trans  &trans  &trans  &trans  &trans  &trans  &trans  &trans  &trans  &trans  &trans  &trans  &trans  &akfix L G   &kp P  &trans  &trans
 &trans  &trans  &trans  &trans  &trans          &trans  &trans  &trans  &trans  &trans  &trans          &trans      &trans  &trans  &trans  &trans
            >;
        };

        layer_ak_F {
            bindings = <
 &trans  &trans  &trans  &trans  &trans                                                                  &trans  &trans  &trans  &trans  &trans
 &trans  &trans  &trans  &trans  &trans  &trans                                                  &trans  &trans  &trans  &trans  &trans  &trans
 &trans  &trans  &trans  &trans  &trans  &trans                                                  &trans  &trans  &trans  &trans  &trans  &trans
 &trans  &trans  &trans  &trans  &trans  &trans                                                  &trans  &trans  &trans  &trans  &trans  &trans
 &trans  &trans  &trans  &trans  &trans  &trans  &trans  &trans  &trans  &trans  &trans  &trans  &trans   &kp L  &trans  &trans  &trans  &trans
 &trans  &trans  &trans  &trans  &trans          &trans  &trans  &trans  &trans  &trans  &trans          &trans  &trans  &trans  &trans  &trans
            >;
        };

    };
};
